## boards/nordic/nrf93m1dk_lm20b/Kconfig.nrf93m1dk_lm20b
```kconfig
# Copyright (c) 2026 Nordic Semiconductor ASA
# SPDX-License-Identifier: Apache-2.0

config BOARD_NRF93M1DK_LM20B
	select SOC_NRF54LM20B_CPUAPP if BOARD_NRF93M1DK_LM20B_NRF54LM20B_CPUAPP || \
		BOARD_NRF93M1DK_LM20B_NRF54LM20B_CPUAPP_NS
	select SOC_NRF54LM20B_CPUFLPR if BOARD_NRF93M1DK_LM20B_NRF54LM20B_CPUFLPR
```

## boards/nordic/nrf93m1dk_lm20b/board.yml
```yaml
board:
  name: nrf93m1dk_lm20b
  full_name: nRF93M1 DK (nRF54LM20B)
  vendor: nordic
  revision:
    format: major.minor.patch
    default: "0.5.0"
    revisions:
    - name: "0.5.0"
  socs:
  - name: nrf54lm20b
    variants:
    - name: ns
      cpucluster: cpuapp
runners:
  run_once:
    '--recover':
    - runners:
      - nrfutil
      run: first
      groups:
      - boards:
        - nrf93m1dk_lm20b@0.5.0/nrf54lm20b/cpuapp
        - nrf93m1dk_lm20b@0.5.0/nrf54lm20b/cpuapp/ns
        - nrf93m1dk_lm20b@0.5.0/nrf54lm20b/cpuflpr
    '--erase':
    - runners:
      - jlink
      - nrfutil
      run: first
      groups:
      - boards:
        - nrf93m1dk_lm20b@0.5.0/nrf54lm20b/cpuapp
        - nrf93m1dk_lm20b@0.5.0/nrf54lm20b/cpuapp/ns
        - nrf93m1dk_lm20b@0.5.0/nrf54lm20b/cpuflpr
    '--reset':
    - runners:
      - jlink
      - nrfutil
      run: last
      groups:
      - boards:
        - nrf93m1dk_lm20b@0.5.0/nrf54lm20b/cpuapp
        - nrf93m1dk_lm20b@0.5.0/nrf54lm20b/cpuapp/ns
        - nrf93m1dk_lm20b@0.5.0/nrf54lm20b/cpuflpr
```
